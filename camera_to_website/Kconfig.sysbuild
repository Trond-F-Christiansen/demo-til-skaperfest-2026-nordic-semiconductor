## camera_to_website/src/modules/camera/Kconfig.camera
```kconfig
#
# Copyright (c) 2026 Nordic Semiconductor ASA
#
# SPDX-License-Identifier: LicenseRef-Nordic-5-Clause
#

menu "Camera"

config CAMERA_TO_WEBSITE_CAMERA_WIDTH
	int "Capture width"
	default 128
	help
	  Must be an exact width the Arducam Mega supports, paired with
	  CAMERA_TO_WEBSITE_CAMERA_HEIGHT: 96x96, 128x128, 320x240, 320x320, 640x480,
	  1280x720, 1600x1200, or the sensor's maximum. Anything else makes
	  video_set_format() fail with -ENOTSUP. High resolutions do not fit on this
	  device: the whole JPEG has to fit in
	  CAMERA_TO_WEBSITE_PAYLOAD_CHANNEL_STRING_MAX_SIZE bytes, which is itself bounded by
	  the RAM the modem and TF-M leave for the application.

config CAMERA_TO_WEBSITE_CAMERA_HEIGHT
	int "Capture height"
	default 128
	help
	  See CAMERA_TO_WEBSITE_CAMERA_WIDTH.

config CAMERA_TO_WEBSITE_CAMERA_THREAD_STACK_SIZE
	int "Thread stack size"
	default 4096
	help
	  The captured image lives in a static buffer rather than on this stack, so
	  this only has to cover the capture loop and logging.

config CAMERA_TO_WEBSITE_CAMERA_MESSAGE_QUEUE_SIZE
	int "Message queue size"
	default 5
	help
	  ZBus subscriber message queue size.

module = CAMERA_TO_WEBSITE_CAMERA
module-str = Camera
source "subsys/logging/Kconfig.template.log_config"

endmenu # Camera
```

## camera_to_website/src/modules/transport/Kconfig.transport
```kconfig
#
# Copyright (c) 2023 Nordic Semiconductor
#
# SPDX-License-Identifier: LicenseRef-Nordic-5-Clause
#

menu "Transport"

config CAMERA_TO_WEBSITE_TRANSPORT_HOSTNAME
	string "HTTPS API hostname"
	default "example.fly.dev"

config CAMERA_TO_WEBSITE_TRANSPORT_DEVICE_TOKEN
	string "HTTPS device token"
	help
	  Bearer token used to authenticate photo uploads.

config CAMERA_TO_WEBSITE_TRANSPORT_SEC_TAG
	int "TLS security tag"
	default 955
	help
	  Security tag containing the CA certificate for the HTTPS API hostname.

config CAMERA_TO_WEBSITE_TRANSPORT_THREAD_STACK_SIZE
	int "Thread stack size"
	default 2048

config CAMERA_TO_WEBSITE_TRANSPORT_MESSAGE_QUEUE_SIZE
	int "Message queue size"
	default 5
	help
	  ZBus subscriber message queue size.

config CAMERA_TO_WEBSITE_TRANSPORT_WORKQUEUE_STACK_SIZE
	int "Workqueue stack size"
	default 4096
	help
	  Stack size of the module's internal workqueue.

module = CAMERA_TO_WEBSITE_TRANSPORT
module-str = Transport
source "subsys/logging/Kconfig.template.log_config"

endmenu # Transport
```

## game_controller/Kconfig
```kconfig
#
# Copyright (c) 2026 Nordic Semiconductor ASA
#
# SPDX-License-Identifier: LicenseRef-Nordic-5-Clause
#

menu "Game controller application"

config KWS_ONLY
	bool "Run KWS only (skip the gesture engine)"
	default n
	help
	  Leave the gesture engine out of the build, so the app never touches
	  the BMI270 IMU. No longer needed just to boot without the IMU: an
	  engine whose init() fails is marked unavailable and skipped, so the
	  KWS engines come up regardless of whether the IMU is jumper-wired in.
	  Enable it only to skip the IMU bring-up entirely -- with it set, btn1
	  (snake driven by swipe gestures) has no engine to select and does
	  nothing.

config KWS_EMA_ALPHA
	int "Exponential moving average coefficient for class probability"
	range 0 1000
	default 120
	help
	  Coefficient for new entries in exponential moving average calculation for average class
	  probability. The value is expressed in units of 1/1000.

endmenu

source "Kconfig.zephyr"
```

## hub_to_website/nrf9151_mqtt/src/modules/transport/Kconfig.transport
```kconfig
#
# Copyright (c) 2023 Nordic Semiconductor
#
# SPDX-License-Identifier: LicenseRef-Nordic-5-Clause
#

menu "Transport"

config MQTT_SAMPLE_TRANSPORT_HOSTNAME
	string "HTTPS API hostname"
	default "example.fly.dev"

config MQTT_SAMPLE_TRANSPORT_DEVICE_TOKEN
	string "HTTPS device token"
	help
	  Bearer token used to authenticate score uploads.

config MQTT_SAMPLE_TRANSPORT_SEC_TAG
	int "TLS security tag"
	default 955
	help
	  Security tag containing the CA certificate for the HTTPS API hostname.

config MQTT_SAMPLE_TRANSPORT_THREAD_STACK_SIZE
	int "Thread stack size"
	default 2048

config MQTT_SAMPLE_TRANSPORT_MESSAGE_QUEUE_SIZE
	int "Message queue size"
	default 5
	help
	  ZBus subscriber message queue size.

config MQTT_SAMPLE_TRANSPORT_WORKQUEUE_STACK_SIZE
	int "Workqueue stack size"
	default 4096
	help
	  Stack size of the module's internal workqueue.

module = MQTT_SAMPLE_TRANSPORT
module-str = Transport
source "subsys/logging/Kconfig.template.log_config"

endmenu # Transport
```

## nrf9151_mqtt/Kconfig
```kconfig
#
# Copyright (c) 2023 Nordic Semiconductor ASA
#
# SPDX-License-Identifier: LicenseRef-Nordic-5-Clause
#

menu "MQTT sample"

config MQTT_SAMPLE_PAYLOAD_CHANNEL_STRING_MAX_SIZE
	int "Payload maximum string size"
	default 100
	help
	  Maximum size of the string included messages that are sent over the payload channel.

config MQTT_SAMPLE_PAYLOAD_CHANNEL_TOPIC_MAX_SIZE
	int "Payload maximum topic size"
	default 64
	help
	  Maximum size of the MQTT topic carried alongside each payload.

rsource "src/modules/network/Kconfig.network"
rsource "src/modules/transport/Kconfig.transport"
rsource "src/modules/error/Kconfig.error"
rsource "src/modules/led/Kconfig.led"
rsource "src/modules/uart_bridge/Kconfig.uart_bridge"

endmenu

menu "Zephyr Kernel"
source "Kconfig.zephyr"
endmenu
```

## nrf9151_mqtt/src/modules/uart_bridge/Kconfig.uart_bridge
```kconfig
#
# Copyright (c) 2026 Nordic Semiconductor ASA
#
# SPDX-License-Identifier: LicenseRef-Nordic-5-Clause
#

menu "UART bridge"

module = MQTT_SAMPLE_UART_BRIDGE
module-str = UART bridge
source "subsys/logging/Kconfig.template.log_config"

endmenu # UART bridge
```
