## CMakeLists.txt
```
cmake_minimum_required(VERSION 3.20.0)

find_package(Zephyr REQUIRED HINTS $ENV{ZEPHYR_BASE})
project(game_receiver)

target_include_directories(app PRIVATE src)

target_sources(app PRIVATE
  src/main.c
  src/ble/ble_central.c
  src/led_status/led_status.c
  src/score_bridge/score_bridge.c
  src/test_button/test_button.c
)
```

## prj.conf
```kconfig
#
# Copyright (c) 2026 Nordic Semiconductor ASA
#
# SPDX-License-Identifier: LicenseRef-Nordic-5-Clause
#

# Logging and console
CONFIG_LOG=y
CONFIG_CONSOLE=y
CONFIG_SERIAL=y
CONFIG_ASSERT=y
CONFIG_LOG_DEFAULT_LEVEL=3

#new: interrupt driven uart for uart_game
CONFIG_UART_INTERRUPT_DRIVEN=y

# GPIO for the temporary sw0 test-score button.
CONFIG_GPIO=y

# Keep printk off the deferred-log path so the forwarded "Command: X" line is
# emitted synchronously (matches the game_controller convention for its
# serial game-controller protocol).
CONFIG_LOG_PRINTK=n

# Bluetooth: central role, connects to the game_controller peripheral and
# subscribes to its Nordic UART Service (NUS) notifications.
CONFIG_BT=y
CONFIG_BT_CENTRAL=y
CONFIG_BT_GATT_CLIENT=y
CONFIG_BT_DEVICE_NAME="Game Receiver"

CONFIG_BT_GATT_DM=y
CONFIG_BT_NUS_CLIENT=y

CONFIG_BT_SCAN=y
CONFIG_BT_SCAN_FILTER_ENABLE=y
CONFIG_BT_SCAN_UUID_CNT=1
CONFIG_BT_SCAN_ADDRESS_CNT=1
```

## src/main.c
```c
/*
 * Copyright (c) 2026 Nordic Semiconductor ASA
 *
 * SPDX-License-Identifier: LicenseRef-Nordic-5-Clause
 *
 * @brief Game receiver entry point.
 *
 * Bridges the game_controller's BLE commands onto this board's console
 * UART: connects as a NUS central and relays every received token as a
 * "Command: <token>" console line.
 */

#include <zephyr/kernel.h>
#include <zephyr/logging/log.h>

#include "ble/ble_central.h"
#include "score_bridge/score_bridge.h"
#include "test_button/test_button.h"

LOG_MODULE_REGISTER(main);

int main(void)
{
	int err;

	err = score_bridge_init();
	if (err) {
		LOG_ERR("Score bridge init failed (err %d)", err);
		return err;
	}



	/* TEMPORARY: sw0 sends a test score until the game console can. */
	err = test_button_init();
	if (err) {
		LOG_ERR("Test button init failed (err %d)", err);
		return err;
	}

	err = ble_central_init();
	if (err) {
		LOG_ERR("BLE central init failed (err %d)", err);
		return err;
	}

	return 0;
}
```
